## components/network_cli/Kconfig
```kconfig
menu "AD2iot * Network CLI"
    config AD2IOT_NETWORK_CLI
        bool "Enable network CLI support"
        default y
        help
            Compile the authenticated TCP command-line server. The server is
            still disabled at runtime until it is configured with a password
            and enabled in ad2iot.ini or through the USB CLI.
endmenu
```

## components/otaupdate/Kconfig
```kconfig
menu "AD2iot * Firmware update support OTA."
    config AD2IOT_OTAUPDATE
        bool "OTA Firmware Updates"
        default n
        help
            Enable OTA firmware updates.

    config AD2IOT_OTA_MANIFEST_URL
        string "HTTPS firmware manifest URL"
        depends on AD2IOT_OTAUPDATE
        default "https://www.alarmdecoder.com/ad2iotota/ad2iotv11_version_info.json"

    config AD2IOT_OTA_IMAGE_URL_TEMPLATE
        string "HTTPS signed firmware URL template"
        depends on AD2IOT_OTAUPDATE
        default "https://www.alarmdecoder.com/ad2iotota/signed_alarmdecoder_%s_esp32.bin"
        help
            The template must contain one %s placeholder for the build flag.
endmenu
```
